## drivers/misc/mediatek/videox/Kconfig
```kconfig
config MTK_VIDEOX
  bool CONFIG_MTK_VIDEOX
  default n
  help
    CONFIG_MTK_VIDEOX

config MTK_KCAL_CTRL
	bool "MTK_KCAL_CTRL"
	default y
	help
		Enable RGB color calibration.
```
